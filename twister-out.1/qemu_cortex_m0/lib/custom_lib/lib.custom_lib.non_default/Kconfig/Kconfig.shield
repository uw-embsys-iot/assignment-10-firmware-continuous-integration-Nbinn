## twister-out.1/qemu_cortex_m0/lib/custom_lib/lib.custom_lib.non_default/Kconfig/Kconfig.shield
```kconfig
osource "D:/UW_assignment/firmware_workspace/assignment_9/boards/shields/*/Kconfig.shield"
```
